## boards/shields/hydrogen/Kconfig.defconfig
```kconfig
if SHIELD_HYDROGEN_LEFT

config ZMK_KEYBOARD_NAME
    default "Hydrogen keeb"

config ZMK_SPLIT_ROLE_CENTRAL
    default y

endif


if SHIELD_HYDROGEN_LEFT || SHIELD_HYDROGEN_RIGHT

config ZMK_SPLIT
    default y

endif
```

## boards/shields/hydrogen/Kconfig.shield
```kconfig
config SHIELD_HYDROGEN_LEFT
    def_bool $(shields_list_contains,hydrogen_left)

config SHIELD_HYDROGEN_RIGHT
    def_bool $(shields_list_contains,hydrogen_right)
```
